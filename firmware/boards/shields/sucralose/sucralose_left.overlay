/*
 * Copyright (c) 2026 The ZMK Contributors
 *
 * SPDX-License-Identifier: MIT
 */

#include "sucralose.dtsi"

/*
 * XIAO on the front face: COL6 (breakaway strip) is leftmost, then COL0
 * (pinky). COL6 is D13, a Plus-only pad the xiao_d connector does not map,
 * so it is given as a raw port.
 */
&kscan0 {
    col-gpios
        = <&gpio1 1 GPIO_ACTIVE_HIGH>    /* COL6 */
        , <&xiao_d 0 GPIO_ACTIVE_HIGH>   /* COL0 */
        , <&xiao_d 1 GPIO_ACTIVE_HIGH>   /* COL1 */
        , <&xiao_d 2 GPIO_ACTIVE_HIGH>   /* COL2 */
        , <&xiao_d 3 GPIO_ACTIVE_HIGH>   /* COL3 */
        , <&xiao_d 10 GPIO_ACTIVE_HIGH>  /* COL4 */
        , <&gpio0 9 GPIO_ACTIVE_HIGH>   /* COL5  D14 P0.09 (NFC pin, see uicr) */
        ;
};
