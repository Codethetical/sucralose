/*
 * Copyright (c) 2026 The ZMK Contributors
 *
 * SPDX-License-Identifier: MIT
 */

#include "sucralose.dtsi"

&default_transform {
    col-offset = <6>;
};

/* XIAO on the back face: the board is flipped, so COL5 (inner) is leftmost. */
&kscan0 {
    col-gpios
        = <&xiao_d 5 GPIO_ACTIVE_HIGH>   /* COL5 */
        , <&xiao_d 10 GPIO_ACTIVE_HIGH>  /* COL4 */
        , <&xiao_d 3 GPIO_ACTIVE_HIGH>   /* COL3 */
        , <&xiao_d 2 GPIO_ACTIVE_HIGH>   /* COL2 */
        , <&xiao_d 1 GPIO_ACTIVE_HIGH>   /* COL1 */
        , <&xiao_d 0 GPIO_ACTIVE_HIGH>   /* COL0 */
        ;
};
