## firmware/boards/shields/sucralose/Kconfig.shield
```kconfig
# Copyright (c) 2026 The ZMK Contributors
# SPDX-License-Identifier: MIT

config SHIELD_SUCRALOSE_LEFT
    def_bool $(shields_list_contains,sucralose_left)

config SHIELD_SUCRALOSE_RIGHT
    def_bool $(shields_list_contains,sucralose_right)
```
